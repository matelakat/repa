## packages/uwsgi/Config.in
```kconfig
config BR2_PACKAGE_UWSGI
    bool "uwsgi"
    help
        The uWSGI project aims at developing a full stack for building (and
        hosting) clustered/distributed network applications. 

        http://projects.unbit.it/uwsgi/
```

## repa_defconfig
```kconfig
BR2_x86_64=y
BR2_DEFCONFIG="$(CONFIG_DIR)/defconfig"
BR2_TOOLCHAIN_EXTERNAL=y
BR2_TOOLCHAIN_EXTERNAL_CUSTOM=y
BR2_TOOLCHAIN_EXTERNAL_PATH="/data/matelakat/crosstoolng/x-tools/x86_64-unknown-linux-gnu"
BR2_TOOLCHAIN_EXTERNAL_CUSTOM_PREFIX="$(ARCH)-unknown-linux-gnu"
BR2_TOOLCHAIN_EXTERNAL_CUSTOM_GLIBC=y
# BR2_TOOLCHAIN_EXTERNAL_INET_RPC is not set
BR2_TOOLCHAIN_EXTERNAL_CXX=y
BR2_TARGET_GENERIC_HOSTNAME="vapp"
BR2_TARGET_GENERIC_ISSUE="Welcome to VApp"
BR2_TARGET_GENERIC_GETTY_PORT="tty1"
BR2_TARGET_GENERIC_GETTY_BAUDRATE_KEEP=y
BR2_PACKAGE_BUSYBOX_SHOW_OTHERS=y
BR2_PACKAGE_PYTHON=y
BR2_PACKAGE_OPENSSL=y
BR2_PACKAGE_PCRE=y
BR2_PACKAGE_PCRE_32=y
BR2_PACKAGE_LIBXML2=y
BR2_PACKAGE_DHCP=y
BR2_PACKAGE_DHCP_CLIENT=y
BR2_PACKAGE_NTP=y
BR2_PACKAGE_UWSGI=y
BR2_PACKAGE_KMOD=y
BR2_PACKAGE_UTIL_LINUX=y
BR2_PACKAGE_UTIL_LINUX_LIBBLKID=y
BR2_TARGET_ROOTFS_EXT2=y
```
